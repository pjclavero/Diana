## firmware/esp32/diagnostics/w5500_minimal/sdkconfig.defaults
```kconfig
CONFIG_IDF_TARGET="esp32s3"
CONFIG_ESPTOOLPY_FLASHSIZE_8MB=y
CONFIG_ESP_CONSOLE_UART_DEFAULT=y
CONFIG_ESP_CONSOLE_UART_BAUDRATE=115200
CONFIG_LOG_DEFAULT_LEVEL_INFO=y
CONFIG_ETH_SPI_ETHERNET_W5500=y
```

## firmware/esp32/main/Kconfig.projbuild
```kconfig
menu "Diana · configuracion del modulo"

config DIANA_BROKER_HOST
    string "Host del broker MQTT"
    default "192.168.1.209"
    help
      Direccion del broker Mosquitto en la red local.

      El usuario MQTT del modulo es EXACTAMENTE su module_id, sin prefijo
      (contrato MQTT §8; el prefijo 'module-' se retiro al cerrar F-02). No se
      configura aqui: sale de la identidad aprovisionada en NVS.

      Este valor tiene que coincidir con el nombre por el que el certificado
      del broker esta emitido: la verificacion de nombre de host esta ACTIVA y
      una IP que no figure en el SAN del certificado hara fallar el handshake.

config DIANA_BROKER_PORT
    int "Puerto del broker MQTT"
    default 8883
    range 1 65535
    help
      8883 es el puerto TLS de produccion (P0-2). Configurable para bancos y
      brokers de prueba. El puerto NO decide el cifrado: el esquema lo fija
      DIANA_MQTT_INSECURE_LAB, y por defecto es mqtts://.

config DIANA_MQTT_INSECURE_LAB
    bool "LABORATORIO: MQTT en claro (mqtt://), SIN TLS"
    default n
    help
      PELIGRO. Activa un perfil de banco que conecta en claro y sin verificar
      al broker. Cualquiera en la red puede leer y suplantar el trafico del
      modulo, incluidas las credenciales MQTT.

      Existe unicamente para depurar contra un Mosquitto de pruebas sin TLS. NO
      es un fallback: el firmware nunca cae a este modo por su cuenta. Si la CA
      falta o es invalida con TLS activo, el modulo NO CONECTA -- no degrada a
      claro. Hay que venir aqui y activarlo a mano.

      Con esta opcion activa el arranque emite un aviso ruidoso por consola en
      cada conexion. Debe estar DESACTIVADA en toda imagen de operacion.

config DIANA_NTP_HOST
    string "Host NTP"
    default "192.168.1.209"
    help
      Servidor de hora, normalmente el propio backend: la instalacion no
      necesita salida a Internet.

      IMPORTANTE: la caducidad de comandos se mide contra 'issued_at_ms', que es
      hora de pared (hallazgo H-05). Sin hora sincronizada el modulo SIGUE
      operando, pero no puede verificar la caducidad: la defensa contra
      reproduccion pasa a ser unicamente el nonce persistido, y cada comando
      aceptado lo declara en 'last_command.detail'.

config DIANA_QUEUE_DROP_OLDEST
    bool "Cola llena: descartar el evento mas antiguo"
    default y
    help
      Politica cuando la cola local de eventos no confirmados se llena.
      Activado  : se descarta el mas antiguo y se conserva el reciente.
      Desactivado: se rechaza el nuevo y se conserva el historico.
      En ambos casos se emite un diagnostico 'queue_overflow'.

config DIANA_BENCH_HIT_LED_TEST
    bool "Banco: armar D1-D3 para probar impacto -> aro"
    default n
    help
      Modo exclusivo de validacion fisica. D1, D2 y D3 quedan activas y cada
      impacto aceptado cambia el aro correspondiente a HIT antes de rearmarlo.
      Debe permanecer desactivado en las imagenes de operacion normal.

endmenu
```
